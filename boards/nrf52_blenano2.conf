## boards/nrf52_blenano2.conf
```kconfig
CONFIG_NET_L2_BT=y

# network stack settings
CONFIG_NET_IF_UNICAST_IPV6_ADDR_COUNT=3
CONFIG_NET_IF_MCAST_IPV6_ADDR_COUNT=2
CONFIG_NET_CONFIG_INIT_TIMEOUT=0

# bluetooth settings
CONFIG_BT_RX_BUF_COUNT=10
CONFIG_BT_RX_BUF_LEN=128
CONFIG_BT_CTLR_RX_BUFFERS=6
CONFIG_BT_CTLR_TX_BUFFERS=7
CONFIG_BT_RX_STACK_SIZE=2048
CONFIG_BT_L2CAP_TX_BUF_COUNT=6

# SPI for WS2812, uses SPI 0, with SoC->ring data on nrf52 pin 2 (MOSI).
CONFIG_SPI_0=y
CONFIG_SPI_0_NAME="SPI_0"
CONFIG_SPI_0_IRQ_PRI=1
CONFIG_SPI_NRFX=y
CONFIG_SPI_0_NRF_SPI=y
CONFIG_SPI_0_NRF_MOSI_PIN=2
# MISO and SCK aren't used, but must be set. Put them on the solderless
# contacts at the end of the board, opposite the antenna.
CONFIG_SPI_0_NRF_SCK_PIN=6
CONFIG_SPI_0_NRF_MISO_PIN=7

# WS2812 LED ring
CONFIG_WS2812_STRIP_SPI_DEV_NAME="SPI_0"
# Uncomment this if you're using RGB pixels which don't have a white channel.
# (By default, we assume RGBW pixels are used).
# CONFIG_WS2812_HAS_WHITE_CHANNEL=n

# Default IP configuration for IPv6 (gateway)
CONFIG_NET_CONFIG_PEER_IPV6_ADDR="fe80::d4e7:0:0:1"

# LWM2M (gateway)
CONFIG_LWM2M_FIRMWARE_UPDATE_PULL_COAP_PROXY_ADDR="coap://[fe80::d4e7:0:0:1]:5682"
```
